## cellular_modem/Kconfig
```kconfig
menu "Cellular Modem (USB RNDIS)"

    config CELL_MODEM_DEFAULT_APN
        string "Fallback APN when PLMN unknown"
        default "3gnet"
        help
            IMSI/COPS 无法识别运营商时使用的默认 APN。

endmenu
```

## examples/cellular_modem_basic/main/Kconfig.projbuild
```kconfig
menu "IO Expander Test"

    config RUN_IO_EXPANDER_TEST
        bool "Run IO Expander driver test (replaces main.c app_main)"
        default n
        help
            When enabled, the project registers io_expander_test.c as the
            sole SRCS and calls io_expander_test_run() from app_main instead
            of the original cellular_modem_basic flow.

            Use this to isolate-test the IO Expander driver before
            integrating it back into the full application.

endmenu
```

## examples/esp_target_flasher_demo/sdkconfig.defaults
```kconfig
# esp_target_flasher_demo example 工程默认配置
# 这些键在首次 idf.py build 时会被写入 sdkconfig，保证开箱可用。

# ===== esp-serial-flasher UART 传输 =====
CONFIG_SERIAL_FLASHER_PORT_UART=y

# ===== 引脚极性（按你的硬件修改）=====
# 若 RST/BOOT 经反相器（如 V4PRO 板），取消下行注释：
# CONFIG_SERIAL_FLASHER_RESET_INVERT=y
# CONFIG_SERIAL_FLASHER_BOOT_INVERT=y

# ===== 串口日志级别 =====
CONFIG_LOG_DEFAULT_LEVEL_INFO=y

# ===== 目标芯片固定 ESP32-P4（Host）=====
CONFIG_IDF_TARGET="esp32p4"
```

## examples/eth_ch182d_basic/sdkconfig.defaults
```kconfig
# eth_ch182d_basic example 工程默认配置
# 这些键在首次 idf.py build 时会被写入 sdkconfig，保证开箱可用。

# ===== 以太网（ESP32-P4 内置 EMAC）=====
# 启用内部 EMAC + eth 驱动；REFCLK 由 CH182D 外部输入（组件内固定 EXT_IN）。
CONFIG_ETH_ENABLED=y

# ===== 例程默认走 DHCP（如需静态 IP 见下方注释）=====
# CONFIG_ETH_CH182D_USE_STATIC_IP=y
# CONFIG_ETH_CH182D_STATIC_IP="192.168.1.100"
# CONFIG_ETH_CH182D_STATIC_NETMASK="255.255.255.0"
# CONFIG_ETH_CH182D_STATIC_GATEWAY="192.168.1.1"

# ===== lwIP：允许运行时切静态 IP（dhcp client + 静态配置共存）=====
CONFIG_LWIP_DHCP_DOES_ARP_CHECK=n

# ===== 串口日志级别 =====
CONFIG_LOG_DEFAULT_LEVEL_INFO=y
```

## packages/eth_ch182d/Kconfig
```kconfig
menu "CH182D Ethernet"

    config ETH_CH182D_USE_STATIC_IP
        bool "Boot with static IP instead of DHCP"
        default n
        help
            默认 n：启动后立即 DHCP。
            选 y 后，可在下方填写静态 IP/掩码/网关；运行时仍可用
            eth_ch182d_enable_dhcp() 切回 DHCP。

    config ETH_CH182D_STATIC_IP
        string "Static IP address"
        default "192.168.1.100"
        depends on ETH_CH182D_USE_STATIC_IP

    config ETH_CH182D_STATIC_NETMASK
        string "Static netmask"
        default "255.255.255.0"
        depends on ETH_CH182D_USE_STATIC_IP

    config ETH_CH182D_STATIC_GATEWAY
        string "Static gateway"
        default "192.168.1.1"
        depends on ETH_CH182D_USE_STATIC_IP

endmenu
```

## performeter/Kconfig.performeter
```kconfig
menu "Performeter"
    config PERFORMETER_ENABLE
        bool "Enable Performeter background task by default"
        default y
        help
            Whether the Performeter background sampling task is enabled at build
            time. Disable to strip out the monitor entirely (saves flash/RAM).

    config PERFORMETER_PERIOD_MS
        int "Default sampling period (ms)"
        default 1000
        range 200 5000
        help
            Interval between two performance snapshots. Longer windows give
            smoother numbers but slower response. Recommended 200-5000 ms.

    config PERFORMETER_LOG_TASKS_TOPN
        int "Top-N CPU tasks to log per sample"
        default 8
        range 1 32
        help
            How many of the most CPU-consuming tasks to print each cycle.

    config PERFORMETER_TASK_STACK
        int "Background task stack size (bytes)"
        default 4096
        help
            Stack allocated for the Performeter background task.

    config PERFORMETER_LOG_LEVEL_OVERRIDE
        int "Performeter log level (0=none,5=verbose)"
        default 0
        range 0 5
        help
            0 = follow global LOG_DEFAULT_LEVEL; otherwise force this level.
endmenu
```

## performeter/example/sdkconfig.defaults
```kconfig
# Performeter example 工程默认配置
# 这些键在首次 idf.py build 时会被写入 sdkconfig，保证开箱可用。
# 详见 DESIGN.md §2.3。

# ===== FreeRTOS 运行时统计（performeter 的硬性前置）=====
CONFIG_FREERTOS_GENERATE_RUN_TIME_STATS=y
CONFIG_FREERTOS_USE_TRACE_FACILITY=y
CONFIG_FREERTOS_USE_STATS_FORMATTING_FUNCTIONS=y

# 使用 esp_timer 作为 run-time stats 时基（IDF v5 默认即此，显式写明以防被覆盖）。
CONFIG_FREERTOS_GENERATE_RUN_TIME_STATS_USING_ESP_TIMER=y

# ===== Performeter 组件默认 =====
CONFIG_PERFORMETER_ENABLE=y
CONFIG_PERFORMETER_PERIOD_MS=1000
CONFIG_PERFORMETER_LOG_TASKS_TOPN=8
CONFIG_PERFORMETER_TASK_STACK=4096

# ===== Task Watchdog (TWDT) =====
# 本 example 不创建任何负载任务，IDLE 任务正常运行并喂狗，无需调整 TWDT。
# 保持 IDF 默认即可。若你在自己的工程里加入长时间不让出的负载任务，
# 需在该任务内调用 esp_task_wdt_reset() 主动喂狗。
CONFIG_ESP_TASK_WDT=y

# ===== 串口日志级别 =====
# 默认 INFO 足以看到 performeter 的周期输出。
CONFIG_LOG_DEFAULT_LEVEL_INFO=y
```
